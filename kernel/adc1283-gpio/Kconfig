## kernel/adc1283-gpio/Kconfig
```kconfig
config ADC1283_GPIO
	tristate "ADC1283 GPIO bit-banged IIO ADC driver"
	depends on GPIOLIB
	depends on IIO
	help
	  IIO ADC driver for the ST ADC1283 using DAPHNE mezzanine
	  PS MIO GPIO pins.

	  This driver is intentionally ADC1283-specific. It does not expose
	  a generic SPI master or a spidev node. Instead, it implements the
	  ADC1283 32-clock conversion/read sequence directly and exposes
	  the eight input channels through the Linux IIO subsystem.

	  The intended DAPHNE target clock is 800 kHz.
```

## kernel/daphne-mezz-spi-gpio/Kconfig
```kconfig
config SPI_DAPHNE_MEZZ_GPIO
	tristate "DAPHNE calibrated mezzanine GPIO SPI master"
	depends on GPIOLIB
	help
	  SPI master driver for the DAPHNE mezzanine PS MIO SPI-style lines.
	  It exposes normal Linux SPI devices while using calibrated GPIO
	  timing for lower jitter than the generic spi-gpio driver.
```
